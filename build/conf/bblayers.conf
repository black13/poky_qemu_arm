## build/conf/bblayers.conf
```bitbake
# POKY_BBLAYERS_CONF_VERSION is increased each time build/conf/bblayers.conf
# changes incompatibly
POKY_BBLAYERS_CONF_VERSION = "2"

BBPATH = "${TOPDIR}"
BBFILES ?= ""

BBLAYERS ?= " \
  /home/jjosburn/Documents/programming/poky_qemu_arm/poky/meta \
  /home/jjosburn/Documents/programming/poky_qemu_arm/poky/meta-poky \
  /home/jjosburn/Documents/programming/poky_qemu_arm/poky/meta-yocto-bsp \
  "
```
